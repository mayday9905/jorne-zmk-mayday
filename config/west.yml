## config/west.yml
```yaml
manifest:
  remotes:
    - name: zmkfirmware
      url-base: https://github.com/mayday9905
  projects:
    - name: zmk-1
      remote: mayday9905
      revision: main
      import: app/west.yml
  self:
    path: config
```
